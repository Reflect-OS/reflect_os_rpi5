## Config.in
```kconfig
menu "Custom Packages"
    # This is admittedly hacky, but should be fixed in the next
    # BuildRoot release: https://gitlab.com/buildroot.org/buildroot/-/commit/c7109e265cb6c179dd51a02637bb5f97f4767d21 
    source "$NERVES_DEFCONFIG_DIR/packages/fbv_custom/Config.in"
endmenu
```

## packages/fbv_custom/Config.in
```kconfig
config BR2_PACKAGE_FBV_CUSTOM
	bool "fbv"
	help
	  fbv is a very simple graphic file viewer for the framebuffer
	  console, capable of displaying GIF, JPEG, PNG and BMP files
	  using libungif, libjpeg and libpng.

	  http://freshmeat.net/projects/fbv/

if BR2_PACKAGE_FBV_CUSTOM

config BR2_PACKAGE_FBV_CUSTOM_PNG
	bool "PNG support"
	default y
	select BR2_PACKAGE_LIBPNG
	help
	  Enable support for PNG using libpng.

config BR2_PACKAGE_FBV_CUSTOM_JPEG
	bool "JPEG support"
	default y
	select BR2_PACKAGE_JPEG
	help
	  Enable support for JPEG using IJG's libjpeg.

config BR2_PACKAGE_FBV_CUSTOM_GIF
	bool "GIF support"
	default y
	select BR2_PACKAGE_GIFLIB
	help
	  Enable support for GIF using giflib.

endif # BR2_PACKAGE_FBV_CUSTOM
```
